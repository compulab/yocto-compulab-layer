## conf/machine/cm-fx6-evk.conf
```bitbake
#@TYPE: Machine
#@NAME: CompuLab CM-FX6
#@SOC: i.MX6 Q
#@DESCRIPTION: Machine configuration for CompuLab CM-FX6 machines
#@MAINTAINER: Valentin Raevsky <valentin@compulab.co.il>

require conf/machine/include/imx-base.inc
require conf/machine/include/tune-cortexa9.inc

SOC_FAMILY = "mx6:mx6q"

PREFERRED_PROVIDER_u_boot_cm-fx6-evk = "u-boot-compulab"
PREFERRED_PROVIDER_virtual/bootloader_cm-fx6-evk = "u-boot-compulab"
PREFERRED_PROVIDER_virtual/kernel_cm-fx6-evk = "linux-compulab"

do_rootfs[depends] += "u-boot-script-compulab:do_deploy"

BOOT_SCRIPTS = "boot.scr-${MACHINE}:boot.scr"

UBOOT_MACHINE ?= "cm_fx6_defconfig"

IMAGE_FSTYPES = "sdcard.xz tar.xz"

KERNEL_DEVICETREE = "imx6dl-cm-fx6.dtb imx6dl-sbc-fx6.dtb imx6dl-sbc-fx6m.dtb imx6q-cm-fx6.dtb imx6q-sbc-fx6.dtb imx6q-sbc-fx6m.dtb imx6q-sbc-fx6-mipi.dtb imx6q-sbc-fx6-hdmi.dtb imx6dl-sbc-fx6-mipi.dtb imx6dl-sbc-fx6-hdmi.dtb"

MACHINE_FEATURES += "pci wifi bluetooth alsa bluetooth serial usbhost wifi"

MACHINE_FIRMWARE_append_mx6 += "linux-firmware-sd8787"

SERIAL_CONSOLE = "115200 ttymxc3"
```
